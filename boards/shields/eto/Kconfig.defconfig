## boards/shields/eto/Kconfig.defconfig
```kconfig
if SHIELD_ETO

config ZMK_KEYBOARD_NAME
    default "eto"

config SPI
    default y

config SSD16XX
    default y


choice ZMK_DISPLAY_STATUS_SCREEN
    default ZMK_DISPLAY_STATUS_SCREEN_CUSTOM
endchoice

config ZMK_DISPLAY_STATUS_SCREEN_CUSTOM
    select LV_USE_LABEL
    select LV_USE_IMG
    select LV_USE_CANVAS
    select LV_USE_ANIMIMG 
    select LV_USE_ANIMATION
    select LV_USE_LINE 
    select LV_FONT_UNSCII_8
    select ZMK_WPM
    imply ZMK_HID_INDICATORS

config ZMK_DONGLE_DISPLAY_DONGLE_BATTERY
    bool "Show also the battery level of the dongle"
    depends on BT && (!ZMK_SPLIT_BLE || ZMK_SPLIT_ROLE_CENTRAL)

config ZMK_DONGLE_DISPLAY_MAC_MODIFIERS
    bool "Use MacOS modifier symbols instead of the Windows symbols"

choice ZMK_DISPLAY_WORK_QUEUE
    default ZMK_DISPLAY_WORK_QUEUE_DEDICATED
endchoice

config ZMK_DISPLAY_BLANK_ON_IDLE
    default n

config LV_Z_VDB_SIZE
    default 100

config LV_DPI_DEF
    default 130

config LV_Z_MEM_POOL_SIZE
    default 20480

config HEAP_MEM_POOL_SIZE
    default 8192

config LV_Z_BITS_PER_PIXEL
    default 1

endif # SHIELD_ETO
```
